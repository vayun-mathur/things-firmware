## sdkconfig.defaults
```kconfig
# Enable BLE with NimBLE
CONFIG_BT_ENABLED=y
CONFIG_BT_NIMBLE_ENABLED=y
CONFIG_BT_NIMBLE_MAX_CONNECTIONS=1

# Reduce flash usage
CONFIG_BT_NIMBLE_ROLE_CENTRAL=n
CONFIG_BT_NIMBLE_ROLE_OBSERVER=n

# Button GPIO (XIAO ESP32-C3 BOOT button = GPIO9, XIAO ESP32-S3 = GPIO0)
# Adjust if using a different XIAO variant
```
